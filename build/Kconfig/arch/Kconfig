## build/Kconfig/arch/Kconfig
```kconfig
# Load Zephyr Arch Kconfig descriptions.
osource "/Users/johnextremesourcreme/git/zephyrSynth/zephyr/arch/x86/Kconfig"
osource "/Users/johnextremesourcreme/git/zephyrSynth/zephyr/arch/xtensa/Kconfig"
osource "/Users/johnextremesourcreme/git/zephyrSynth/zephyr/arch/sparc/Kconfig"
osource "/Users/johnextremesourcreme/git/zephyrSynth/zephyr/arch/riscv/Kconfig"
osource "/Users/johnextremesourcreme/git/zephyrSynth/zephyr/arch/posix/Kconfig"
osource "/Users/johnextremesourcreme/git/zephyrSynth/zephyr/arch/nios2/Kconfig"
osource "/Users/johnextremesourcreme/git/zephyrSynth/zephyr/arch/mips/Kconfig"
osource "/Users/johnextremesourcreme/git/zephyrSynth/zephyr/arch/arm64/Kconfig"
osource "/Users/johnextremesourcreme/git/zephyrSynth/zephyr/arch/arm/Kconfig"
osource "/Users/johnextremesourcreme/git/zephyrSynth/zephyr/arch/arc/Kconfig"
```

## build/Kconfig/boards/Kconfig
```kconfig
# Load Zephyr board Kconfig descriptions.
osource "/Users/johnextremesourcreme/git/zephyrSynth/zephyr/boards/st/nucleo_f411re/Kconfig"
```

## build/Kconfig/boards/Kconfig.defconfig
```kconfig
# Load Zephyr board defconfig descriptions.
osource "/Users/johnextremesourcreme/git/zephyrSynth/zephyr/boards/st/nucleo_f411re/Kconfig.defconfig"
```

## build/Kconfig/boards/Kconfig.nucleo_f411re
```kconfig
# Load board Kconfig descriptions.
osource "/Users/johnextremesourcreme/git/zephyrSynth/zephyr/boards/st/nucleo_f411re/Kconfig.nucleo_f411re"
```

## build/Kconfig/soc/Kconfig
```kconfig
# Load Zephyr SoC Kconfig descriptions.
osource "/Users/johnextremesourcreme/git/zephyrSynth/zephyr/soc/xlnx/zynqmp/Kconfig"
osource "/Users/johnextremesourcreme/git/zephyrSynth/zephyr/soc/xlnx/zynq7000/Kconfig"
osource "/Users/johnextremesourcreme/git/zephyrSynth/zephyr/soc/xen/Kconfig"
osource "/Users/johnextremesourcreme/git/zephyrSynth/zephyr/soc/wch/ch32v00x/Kconfig"
osource "/Users/johnextremesourcreme/git/zephyrSynth/zephyr/soc/ti/simplelink/Kconfig"
osource "/Users/johnextremesourcreme/git/zephyrSynth/zephyr/soc/ti/lm3s6965/Kconfig"
osource "/Users/johnextremesourcreme/git/zephyrSynth/zephyr/soc/ti/k3/Kconfig"
osource "/Users/johnextremesourcreme/git/zephyrSynth/zephyr/soc/telink/tlsr/Kconfig"
osource "/Users/johnextremesourcreme/git/zephyrSynth/zephyr/soc/starfive/jh71xx/Kconfig"
osource "/Users/johnextremesourcreme/git/zephyrSynth/zephyr/soc/st/stm32/Kconfig"
osource "/Users/johnextremesourcreme/git/zephyrSynth/zephyr/soc/snps/qemu_arc/Kconfig"
osource "/Users/johnextremesourcreme/git/zephyrSynth/zephyr/soc/snps/nsim/arc_v/Kconfig"
osource "/Users/johnextremesourcreme/git/zephyrSynth/zephyr/soc/snps/nsim/arc_classic/Kconfig"
osource "/Users/johnextremesourcreme/git/zephyrSynth/zephyr/soc/snps/hsdk4xd/Kconfig"
osource "/Users/johnextremesourcreme/git/zephyrSynth/zephyr/soc/snps/hsdk/Kconfig"
osource "/Users/johnextremesourcreme/git/zephyrSynth/zephyr/soc/snps/emsk/Kconfig"
osource "/Users/johnextremesourcreme/git/zephyrSynth/zephyr/soc/snps/emsdp/Kconfig"
osource "/Users/johnextremesourcreme/git/zephyrSynth/zephyr/soc/snps/arc_iot/Kconfig"
osource "/Users/johnextremesourcreme/git/zephyrSynth/zephyr/soc/silabs/Kconfig"
osource "/Users/johnextremesourcreme/git/zephyrSynth/zephyr/soc/sifive/sifive_freedom/Kconfig"
osource "/Users/johnextremesourcreme/git/zephyrSynth/zephyr/soc/sensry/Kconfig"
osource "/Users/johnextremesourcreme/git/zephyrSynth/zephyr/soc/rockchip/Kconfig"
osource "/Users/johnextremesourcreme/git/zephyrSynth/zephyr/soc/renode/riscv_virtual/Kconfig"
osource "/Users/johnextremesourcreme/git/zephyrSynth/zephyr/soc/renode/cortex_r8_virtual/Kconfig"
osource "/Users/johnextremesourcreme/git/zephyrSynth/zephyr/soc/renesas/smartbond/Kconfig"
osource "/Users/johnextremesourcreme/git/zephyrSynth/zephyr/soc/renesas/rzt2m/Kconfig"
osource "/Users/johnextremesourcreme/git/zephyrSynth/zephyr/soc/renesas/rz/Kconfig"
osource "/Users/johnextremesourcreme/git/zephyrSynth/zephyr/soc/renesas/rcar/Kconfig"
osource "/Users/johnextremesourcreme/git/zephyrSynth/zephyr/soc/renesas/ra/Kconfig"
osource "/Users/johnextremesourcreme/git/zephyrSynth/zephyr/soc/raspberrypi/Kconfig"
osource "/Users/johnextremesourcreme/git/zephyrSynth/zephyr/soc/quicklogic/eos_s3/Kconfig"
osource "/Users/johnextremesourcreme/git/zephyrSynth/zephyr/soc/qemu/virt_riscv/Kconfig"
osource "/Users/johnextremesourcreme/git/zephyrSynth/zephyr/soc/qemu/malta/Kconfig"
osource "/Users/johnextremesourcreme/git/zephyrSynth/zephyr/soc/openisa/rv32m1/Kconfig"
osource "/Users/johnextremesourcreme/git/zephyrSynth/zephyr/soc/nxp/s32/Kconfig"
osource "/Users/johnextremesourcreme/git/zephyrSynth/zephyr/soc/nxp/rw/Kconfig"
osource "/Users/johnextremesourcreme/git/zephyrSynth/zephyr/soc/nxp/mcx/Kconfig"
osource "/Users/johnextremesourcreme/git/zephyrSynth/zephyr/soc/nxp/lpc/Kconfig"
osource "/Users/johnextremesourcreme/git/zephyrSynth/zephyr/soc/nxp/layerscape/Kconfig"
osource "/Users/johnextremesourcreme/git/zephyrSynth/zephyr/soc/nxp/kinetis/Kconfig"
osource "/Users/johnextremesourcreme/git/zephyrSynth/zephyr/soc/nxp/imxrt/Kconfig"
osource "/Users/johnextremesourcreme/git/zephyrSynth/zephyr/soc/nxp/imx/Kconfig"
osource "/Users/johnextremesourcreme/git/zephyrSynth/zephyr/soc/nuvoton/numicro/Kconfig"
osource "/Users/johnextremesourcreme/git/zephyrSynth/zephyr/soc/nuvoton/numaker/Kconfig"
osource "/Users/johnextremesourcreme/git/zephyrSynth/zephyr/soc/nuvoton/npcx/Kconfig"
osource "/Users/johnextremesourcreme/git/zephyrSynth/zephyr/soc/nuvoton/npcm/Kconfig"
osource "/Users/johnextremesourcreme/git/zephyrSynth/zephyr/soc/nordic/Kconfig"
osource "/Users/johnextremesourcreme/git/zephyrSynth/zephyr/soc/neorv32/Kconfig"
osource "/Users/johnextremesourcreme/git/zephyrSynth/zephyr/soc/native/inf_clock/Kconfig"
osource "/Users/johnextremesourcreme/git/zephyrSynth/zephyr/soc/microchip/miv/Kconfig"
osource "/Users/johnextremesourcreme/git/zephyrSynth/zephyr/soc/microchip/mec/Kconfig"
osource "/Users/johnextremesourcreme/git/zephyrSynth/zephyr/soc/mediatek/mt8xxx/Kconfig"
osource "/Users/johnextremesourcreme/git/zephyrSynth/zephyr/soc/lowrisc/opentitan/Kconfig"
osource "/Users/johnextremesourcreme/git/zephyrSynth/zephyr/soc/litex/litex_vexriscv/Kconfig"
osource "/Users/johnextremesourcreme/git/zephyrSynth/zephyr/soc/ite/ec/Kconfig"
osource "/Users/johnextremesourcreme/git/zephyrSynth/zephyr/soc/intel/raptor_lake/Kconfig"
osource "/Users/johnextremesourcreme/git/zephyrSynth/zephyr/soc/intel/lakemont/Kconfig"
osource "/Users/johnextremesourcreme/git/zephyrSynth/zephyr/soc/intel/intel_socfpga_std/Kconfig"
osource "/Users/johnextremesourcreme/git/zephyrSynth/zephyr/soc/intel/intel_socfpga/Kconfig"
osource "/Users/johnextremesourcreme/git/zephyrSynth/zephyr/soc/intel/intel_niosv/Kconfig"
osource "/Users/johnextremesourcreme/git/zephyrSynth/zephyr/soc/intel/intel_ish/Kconfig"
osource "/Users/johnextremesourcreme/git/zephyrSynth/zephyr/soc/intel/intel_adsp/Kconfig"
osource "/Users/johnextremesourcreme/git/zephyrSynth/zephyr/soc/intel/elkhart_lake/Kconfig"
osource "/Users/johnextremesourcreme/git/zephyrSynth/zephyr/soc/intel/atom/Kconfig"
osource "/Users/johnextremesourcreme/git/zephyrSynth/zephyr/soc/intel/apollo_lake/Kconfig"
osource "/Users/johnextremesourcreme/git/zephyrSynth/zephyr/soc/intel/alder_lake/Kconfig"
osource "/Users/johnextremesourcreme/git/zephyrSynth/zephyr/soc/infineon/cat3/Kconfig"
osource "/Users/johnextremesourcreme/git/zephyrSynth/zephyr/soc/infineon/cat1b/Kconfig"
osource "/Users/johnextremesourcreme/git/zephyrSynth/zephyr/soc/infineon/cat1a/Kconfig"
osource "/Users/johnextremesourcreme/git/zephyrSynth/zephyr/soc/gd/gd32/Kconfig"
osource "/Users/johnextremesourcreme/git/zephyrSynth/zephyr/soc/gaisler/leon3/Kconfig"
osource "/Users/johnextremesourcreme/git/zephyrSynth/zephyr/soc/gaisler/gr716a/Kconfig"
osource "/Users/johnextremesourcreme/git/zephyrSynth/zephyr/soc/espressif/Kconfig"
osource "/Users/johnextremesourcreme/git/zephyrSynth/zephyr/soc/ene/kb1200/Kconfig"
osource "/Users/johnextremesourcreme/git/zephyrSynth/zephyr/soc/efinix/sapphire/Kconfig"
osource "/Users/johnextremesourcreme/git/zephyrSynth/zephyr/soc/cdns/xtensa_sample_controller/Kconfig"
osource "/Users/johnextremesourcreme/git/zephyrSynth/zephyr/soc/cdns/sample_controller32/Kconfig"
osource "/Users/johnextremesourcreme/git/zephyrSynth/zephyr/soc/cdns/dc233c/Kconfig"
osource "/Users/johnextremesourcreme/git/zephyrSynth/zephyr/soc/brcm/bcmvk/Kconfig"
osource "/Users/johnextremesourcreme/git/zephyrSynth/zephyr/soc/brcm/bcm2712/Kconfig"
osource "/Users/johnextremesourcreme/git/zephyrSynth/zephyr/soc/brcm/bcm2711/Kconfig"
osource "/Users/johnextremesourcreme/git/zephyrSynth/zephyr/soc/atmel/sam0/Kconfig"
osource "/Users/johnextremesourcreme/git/zephyrSynth/zephyr/soc/atmel/sam/Kconfig"
osource "/Users/johnextremesourcreme/git/zephyrSynth/zephyr/soc/aspeed/Kconfig"
osource "/Users/johnextremesourcreme/git/zephyrSynth/zephyr/soc/arm/Kconfig"
osource "/Users/johnextremesourcreme/git/zephyrSynth/zephyr/soc/arm/beetle/Kconfig"
osource "/Users/johnextremesourcreme/git/zephyrSynth/zephyr/soc/andestech/Kconfig"
osource "/Users/johnextremesourcreme/git/zephyrSynth/zephyr/soc/amd/acp_6_0/Kconfig"
osource "/Users/johnextremesourcreme/git/zephyrSynth/zephyr/soc/ambiq/Kconfig"
osource "/Users/johnextremesourcreme/git/zephyrSynth/zephyr/soc/altr/zephyr_nios2f/Kconfig"
osource "/Users/johnextremesourcreme/git/zephyrSynth/zephyr/soc/altr/qemu_nios2/Kconfig"
osource "/Users/johnextremesourcreme/git/zephyrSynth/zephyr/soc/adi/max32/Kconfig"
```
